/dts-v1/;
/plugin/;

/ {
        compatible = "rockchip,rk3328";

        fragment@0 {
		target = <&uart1>;
		__overlay__ {
			status = "okay";
			rylr998 {
				compatible = "reyax,rylr998";
				status = "okay";
			};

                };
        };
};
